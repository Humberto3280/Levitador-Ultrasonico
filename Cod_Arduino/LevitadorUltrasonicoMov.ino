//Librerias para ahorro de energia
#include <avr/sleep.h>
#include <avr/power.h>

#define N_PORTS 1 //Numero de puerto con los que se trabaja
#define N_DIVS 24 //Cantidad de divsiones de la matriz

//variables que añaden retrasos en los ciclos de reloj: LOT(mucho retraso), MID(retraso medio), LIT(retraso bajo)
#define WAIT_LOT(a) __asm__ __volatile__ ("nop"); __asm__ __volatile__ ("nop"); __asm__ __volatile__ ("nop");  __asm__ __volatile__ ("nop"); __asm__ __volatile__ ("nop");__asm__ __volatile__ ("nop"); __asm__ __volatile__ ("nop");__asm__ __volatile__ ("nop"); __asm__ __volatile__ ("nop");  __asm__ __volatile__ ("nop"); __asm__ __volatile__ ("nop");__asm__ __volatile__ ("nop");  __asm__ __volatile__ ("nop");  __asm__ __volatile__ ("nop")
#define WAIT_MID(a) __asm__ __volatile__ ("nop"); __asm__ __volatile__ ("nop"); __asm__ __volatile__ ("nop");  __asm__ __volatile__ ("nop"); __asm__ __volatile__ ("nop");__asm__ __volatile__ ("nop"); __asm__ __volatile__ ("nop");__asm__ __volatile__ ("nop"); __asm__ __volatile__ ("nop"); __asm__ __volatile__ ("nop"); __asm__ __volatile__ ("nop"); __asm__ __volatile__ ("nop"); __asm__ __volatile__ ("nop")
#define WAIT_LIT(a) __asm__ __volatile__ ("nop"); __asm__ __volatile__ ("nop"); __asm__ __volatile__ ("nop");  __asm__ __volatile__ ("nop"); __asm__ __volatile__ ("nop");  __asm__ __volatile__ ("nop");  __asm__ __volatile__ ("nop");  __asm__ __volatile__ ("nop");  __asm__ __volatile__ ("nop")

//Defino funcion macro, para las ondas de salida
#define OUTPUT_WAVE(pointer, d)  PORTF = pointer[d*N_PORTS + 0]

//Defino el numero de botones a usar
#define N_BUTTONS 6
//Medio segungo
#define STEP_SIZE 1
#define BUTTON_SENS 2500
#define N_FRAMES 24

//Defino variables y matriz para las diferentes posiciones del eje OZ
static byte frame = 0;
static byte animation[N_FRAMES][N_DIVS] =
{ {0x5, 0x5, 0x5, 0x5, 0x5, 0x5, 0x5, 0x5, 0x5, 0x5, 0x5, 0x5, 0xa, 0xa, 0xa, 0xa, 0xa, 0xa, 0xa, 0xa, 0xa, 0xa, 0xa, 0xa},
  {0x9, 0x5, 0x5, 0x5, 0x5, 0x5, 0x5, 0x5, 0x5, 0x5, 0x5, 0x5, 0x6, 0xa, 0xa, 0xa, 0xa, 0xa, 0xa, 0xa, 0xa, 0xa, 0xa, 0xa},
  {0x9, 0x9, 0x5, 0x5, 0x5, 0x5, 0x5, 0x5, 0x5, 0x5, 0x5, 0x5, 0x6, 0x6, 0xa, 0xa, 0xa, 0xa, 0xa, 0xa, 0xa, 0xa, 0xa, 0xa},
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  {0x5, 0x5, 0x5, 0x5, 0x5, 0x5, 0x5, 0x5, 0x5, 0x5, 0x5, 0x9, 0xa, 0xa, 0xa, 0xa, 0xa, 0xa, 0xa, 0xa, 0xa, 0xa, 0xa, 0x6}
};

//Defino variables asignadas para el bucle
byte* emittingPointer = &animation[frame][0];
byte buttonsPort = 0;

bool anyButtonPressed;
bool buttonPressed[N_BUTTONS];
short buttonCounter = 0;

void setup()
{
  DDRF = 0b00001111; //Defino las salidas analogicas
  PORTF = 0b00000000; //Defino valor inicial de las salidas

  pinMode(10, OUTPUT); //pin 10 (B2) will generate a 40kHz signal to sync
  pinMode(11, INPUT_PULLUP); //pin 11 (B3) is the sync in
  //please connect pin 10 to pin 11

  //BOTONES
  for (int i = 22; i <=27; i++) {
    pinMode(i, INPUT_PULLUP);
  }

  // Genero una señal de sincronizaion de 40KHz en el pin 10
  noInterrupts();           // Deshabilito todas las interrupciones

  //Aplico control y uso contadores para generar PWM con la herramienta del timer
  TCCR1A = bit (WGM10) | bit (WGM11) | bit (COM1B1); //WGM encargados de generar la forma de onda
  TCCR1B = bit (WGM12) | bit (WGM13) | bit (CS10);   //COM Activar o desactivar e invertir la señal de salida
  OCR1A =  (F_CPU / 40000L) - 1;                     //CS permite seleccionar el tipo del prescaler
  OCR1B = (F_CPU / 40000L) / 2;
  interrupts();             // Habilito las interrupciones

  // Desabilito cada cosa que no se este usando, para ahorro de energia
  ADCSRA = 0;  // ADC
  power_adc_disable ();
  power_spi_disable();
  power_twi_disable();
  power_timer0_disable();
  //power_usart0_disable();
  Serial.begin(115200);
}

void loop() {
  while (PINB & 0b00100000); //Espero a que el pin 11 est en bajo

  //Defino la macro antes mencionada con los valores de cada variable designada y su respectivo pin
  OUTPUT_WAVE(emittingPointer, 0); buttonsPort = PINA ; WAIT_LIT();
  OUTPUT_WAVE(emittingPointer, 1); anyButtonPressed = (buttonsPort & 0b00111111) != 0b11111100; WAIT_MID();
  OUTPUT_WAVE(emittingPointer, 2); buttonPressed[0] = buttonsPort & 0b00000001; WAIT_MID();
  OUTPUT_WAVE(emittingPointer, 3); buttonPressed[1] = buttonsPort & 0b00000010; WAIT_MID();
  OUTPUT_WAVE(emittingPointer, 4); buttonPressed[2] = buttonsPort & 0b00000100; WAIT_MID();
  OUTPUT_WAVE(emittingPointer, 5); buttonPressed[3] = buttonsPort & 0b00001000; WAIT_MID();
  OUTPUT_WAVE(emittingPointer, 6); buttonPressed[4] = buttonsPort & 0b00010000; WAIT_MID();
  OUTPUT_WAVE(emittingPointer, 7); buttonPressed[5] = buttonsPort & 0b00100000; WAIT_MID();
  OUTPUT_WAVE(emittingPointer, 8); WAIT_LOT();
  OUTPUT_WAVE(emittingPointer, 9); WAIT_LOT();
  OUTPUT_WAVE(emittingPointer, 10); WAIT_LOT();
  OUTPUT_WAVE(emittingPointer, 11); WAIT_LOT();
  OUTPUT_WAVE(emittingPointer, 12); WAIT_LOT();
  OUTPUT_WAVE(emittingPointer, 13); WAIT_LOT();
  OUTPUT_WAVE(emittingPointer, 14); WAIT_LOT();
  OUTPUT_WAVE(emittingPointer, 15); WAIT_LOT();
  OUTPUT_WAVE(emittingPointer, 16); WAIT_LOT();
  OUTPUT_WAVE(emittingPointer, 17); WAIT_LOT();
  OUTPUT_WAVE(emittingPointer, 18); WAIT_LOT();
  OUTPUT_WAVE(emittingPointer, 19); WAIT_LOT();
  OUTPUT_WAVE(emittingPointer, 20); WAIT_LOT();
  OUTPUT_WAVE(emittingPointer, 21); WAIT_LOT();
  OUTPUT_WAVE(emittingPointer, 22); WAIT_LOT();
  OUTPUT_WAVE(emittingPointer, 23);


  if ( anyButtonPressed ) {
    ++buttonCounter;
    if (buttonCounter > BUTTON_SENS) {
      buttonCounter = 0;

      if (! buttonPressed[0] ) {
        if ( frame < STEP_SIZE ) {
          frame = N_FRAMES - 1;
        } else {
          frame -= STEP_SIZE;
        }
      }
      else if (! buttonPressed[1] ) {
        if ( frame >= N_FRAMES - STEP_SIZE ) {
          frame = 0;
        } else {
          frame += STEP_SIZE;
        }
      } else if (! buttonPressed[2] ) {
        frame = 0;
      }
      emittingPointer = & animation[frame][0];
    }
  } else {
    buttonCounter = 0;
  }
}
